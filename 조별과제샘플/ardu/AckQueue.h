#pragma once
// ═════════════════════════════════════════════════════════════════════════
// AckQueue.h — rid 멱등 캐시 · ACK 보류 큐   (REQ-0273 리팩터링 · 2026-08-19)
//   원본 `조별과제샘플/ardu/client.ino` 의 **531~640 행을 원문 그대로** 옮긴 것이다.
//   ⚠ 행 번호는 **이 분리 이전 판(2980줄) 기준**이다.
// ═════════════════════════════════════════════════════════════════════════
// 🔴🔴 **위치를 옮기지 마라. 순서 보존이 `hex` 차이 0 의 조건이다.**
//   이 파일은 `client.ino` 의 **원래 그 자리에서** `#include` 된다. 다른 자리로 옮기거나
//   헤더들의 순서를 바꾸면 **그 순간 거동 변경이 되고 굽기 축이 하나 는다**(원장 §19·§31).

// ─────────────────────────────────────────────────────────────────────────
// rid 멱등 캐시 (§4.2) — 최근 8건, 결과까지 같이 들고 있는다
// ─────────────────────────────────────────────────────────────────────────
// 🔴 2026-08-18 (REQ-0204) — **8 → 16.** `ACKQ_N` 보다 커야 한다.
//   큐에 든 `rid` 의 **내용은 이 캐시에만 있다**(큐는 rid 만 담는다).
//   **캐시가 큐보다 작으면 큐에 있는데 내용이 사라져** `sendSlotBatch` 가 그것을 버린다 —
//   **큐를 늘려도 캐시가 병목이면 같은 손실이 다른 칸에서 난다.**
static const uint8_t CACHE_N = 16;
struct AckRec {
  uint16_t rid;
  char     slot[2];
  uint8_t  result;
};
static AckRec  cache[CACHE_N];
static uint8_t cacheHead = 0;   // 다음에 덮어쓸 자리
static uint8_t cacheCount = 0;

static int8_t cacheFind(uint16_t rid) {
  for (uint8_t k = 0; k < cacheCount; k++) if (cache[k].rid == rid) return (int8_t)k;
  return -1;
}
// REQ-0032 판정 (a): **새 TCP 연결이 맺어지면 캐시를 비운다.**
// wire_rid 는 서버가 발급하고 서버 재시작 시 1부터 다시 시작한다. 아두이노는 재부팅하지 않았으므로
// 옛 세션의 rid 가 캐시에 남아 새 서버의 1,2,3… 과 충돌하고, 최대 8개 명령이 "재수신"으로 삼켜진다.
// 가장 나쁜 점은 result=0 이라 **성공으로 보인다**는 것이다 — 타임아웃도 오류도 안 난다.
// 비워도 잃는 것이 없다: §7.3 재전송(1500ms·2회)은 전부 살아 있는 연결 위에서 끝나고,
// 연결이 끊기면 §7.4 가 새 wire_rid 로 재하달한다. rid 를 가로질러 재전송이 이어지는 경로가 없다.
static void cacheClear(void) {
  cacheHead = 0;
  cacheCount = 0;
}

static void cachePut(uint16_t rid, char s0, char s1, uint8_t result) {
  cache[cacheHead].rid = rid;
  cache[cacheHead].slot[0] = s0;
  cache[cacheHead].slot[1] = s1;
  cache[cacheHead].result = result;
  cacheHead = (uint8_t)((cacheHead + 1) % CACHE_N);
  if (cacheCount < CACHE_N) cacheCount++;
}

// ─────────────────────────────────────────────────────────────────────────
// 🔴 ACK 보류 큐 — **게이트가 닫혀 있을 때 ACK 가 조용히 사라지던 것을 막는다**
//    (2026-08-17 · 사용자 재현 13:20:22 · 설계서 §5-U)
//
// 무엇이 문제였나:
//   `handleLine()` 이 `cachePut()` 으로 **상태를 커밋한 뒤** `sendAck()` 를 부르는데
//   **반환값을 안 썼다.** 그리고 `sendLine()` 은 게이트가 닫혀 있으면 `false` 를 돌려준다.
//   → **장치는 하행을 받고 적용까지 했는데 ACK 만 사라진다. 아무도 재시도하지 않는다.**
//   실측: 서버가 같은 `rid` 를 3번 재전송했고 **3번 다 같은 닫힌 게이트를 만났다.**
//
// ⚠ 그래서 **서버측 재전송 강화는 이 결함의 해법이 아니다.**
// ⚠ 그리고 **게이트에서 ACK 를 면제하는 것도 해법이 아니다** — 게이트가 닫힌 이유가
//   "ESP 가 아직 전송 중"이라서다. 면제해도 `busy` 로 거부된다. **미루는 것 말고 답이 없다.**
//
// 왜 이렇게 작은가 — **내용은 이미 멱등 캐시가 갖고 있다.**
//   잃는 것은 "무엇을 보낼지"가 아니라 **"보내야 한다는 사실"** 하나뿐이다.
//   그래서 큐는 `rid` 목록이면 되고, 보낼 때 캐시에서 다시 만든다.
//   ⚠ RAM 이 빠듯하다(실측 최저 여유 782B). 프레임을 통째로 담으면 한 칸 64바이트라 32배다.
//
// 멱등 캐시와 겹치지 않는다 — **직교한다:**
//   · 캐시 = 같은 `rid` 가 **또 오면** 상태를 다시 안 바꾼다 (중복 **수신**)
//   · 큐   = 만든 답을 **못 보냈으면** 나중에 보낸다      (송신 **지연**)
// 🔴 2026-08-18 (REQ-0204) — **4 → 12.** 옛 근거가 틀렸다.
//   ~~"60초 간격이면 1이면 충분. 사람이 연달아 누르는 경우를 위해 4"~~
//   **사용자는 20~30번 연타한다.** 실측: `ackdrop +31`(서로 다른 rid 31개 — 아래 중복 방지가 있으므로).
//   서버는 그 rid 를 3회 재전송하고 `ack_timeout` 을 냈고, 화면에 **"장치가 응답하지 않았습니다"** 가 떴다.
//
// ★ 새 값의 근거는 **"몇 명이 누르나"가 아니라 "배출이 멈추는 최악 구간"** 이다:
//   배출은 슬롯마다 도는데(1.2초) **오프라인·게이트 닫힘 구간에는 0 이다.**
//   `TX_STALL_MS = 10000` 이 그 최악을 10초로 묶는다 → **10초 × 1건/초(web 전역 아이들) = 10건.**
//   여유 2 를 더해 **12**. ⚠ **유입률이 바뀌면(아이들 제거 등) 이 값도 다시 계산해야 한다.**
static const uint8_t ACKQ_N = 12;

// 🔴 **불변식: `CACHE_N >= ACKQ_N`.** 주석이 아니라 **컴파일이 막는다.**
//   큐는 `rid` 만 담고 **내용은 캐시에만 있다.** 캐시가 더 작으면 **큐에 있는데 내용이 사라져**
//   `sendSlotBatch` 가 그것을 버린다(`ackstale`) — **큐만 늘리면 손실이 다른 칸으로 옮겨갈 뿐이다.**
//   ★ 원장 §8.2-14: **규칙을 적어 두는 것과 그 규칙이 적용되게 하는 것은 다른 물건이다.**
//     그래서 문장이 아니라 **다음 사람이 큐만 올리면 빌드가 깨지는 형태**로 둔다.
static_assert(CACHE_N >= ACKQ_N,
              "CACHE_N 은 ACKQ_N 이상이어야 한다 — 큐는 rid 만 담고 내용은 캐시에 있다");
static uint16_t      ackq[ACKQ_N];
static uint8_t       ackqCount = 0;
static uint8_t       ackqHead  = 0;   // 다음에 내보낼 자리
static uint16_t      ackqDrops = 0;   // ★ **큐가 가득 차서** 밀어낸 수 (유입 초과)
// 🔴 2026-08-18 (REQ-0204) — **원인을 갈라 센다.** 예전에는 아래 둘이 같은 칸이었다:
//     ① 큐가 가득 참        → 유입이 배출보다 빠르다      → 대책: 큐/배출을 키운다
//     ② 캐시에서 밀려남      → 캐시가 큐보다 작다          → 대책: 캐시를 키운다
//   **대책이 다른데 한 칸이었다.** `ackdrop 31` 이 어느 쪽인지 아무도 몰랐다.
//   ★ 원장 §5.1 과 같은 뿌리 — **합쳐 세면 "무엇을 고쳐야 하나"를 못 읽는다.**
static uint16_t      ackqStale = 0;   // ★ **캐시에서 밀려나** 내용을 만들 수 없어 버린 수

static void ackqPush(uint16_t rid) {
  for (uint8_t i = 0; i < ackqCount; i++)                    // 같은 rid 가 이미 있으면 안 넣는다
    if (ackq[(uint8_t)((ackqHead + i) % ACKQ_N)] == rid) return;
  if (ackqCount == ACKQ_N) {
    ackqHead = (uint8_t)((ackqHead + 1) % ACKQ_N);           // 가장 오래된 것을 버린다
    ackqCount--;
    if (ackqDrops < 65535) ackqDrops++;
#if DEBUG
    Serial.println(F("[ACKQ] 가득 참 — 가장 오래된 보류 ACK 를 버린다"));
#endif
  }
  ackq[(uint8_t)((ackqHead + ackqCount) % ACKQ_N)] = rid;
  ackqCount++;
}

// ★ 소켓이 끊기면 비운다 — **새 소켓에서 옛 `rid` 에 답하면 안 된다.**
//   이 설계가 새로 만드는 유일한 위험이 그것이라 `awaitingSendOk=false` 와 같은 자리에 둔다.
static void ackqClear(void) { ackqCount = 0; ackqHead = 0; }
